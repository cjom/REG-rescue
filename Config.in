## Config.in
```kconfig
menu "REG.rescue"

menu "System"
	source "$BR2_EXTERNAL_RESCUE_PATH/package/core/rescue-system/Config.in"
endmenu

menu "Boot"
	source "$BR2_EXTERNAL_RESCUE_PATH/package/boot/plymouth/Config.in"
endmenu

menu "Tools"
	source "$BR2_EXTERNAL_RESCUE_PATH/package/tools/install2emmc/Config.in"
endmenu

endmenu
```

## package/core/rescue-system/Config.in
```kconfig
# Targets
config BR2_PACKAGE_RESCUE_TARGET_AARCH64
	bool "aarch64"
config BR2_PACKAGE_RESCUE_TARGET_ARMHF
	bool "armhf"
config BR2_PACKAGE_RESCUE_TARGET_ARMV7
	bool "armv7"
config BR2_PACKAGE_RESCUE_TARGET_RISCV64
	bool "riscv64"
config BR2_PACKAGE_RESCUE_TARGET_X86_64
	bool "x86_64"
config BR2_PACKAGE_RESCUE_TARGET_MIPSEL
	bool "mipsel"

config BR2_PACKAGE_RESCUE_SYSTEM
	bool "REG Rescue"

	# RISC-V support needs a hack here to declare as RV64GC, needed for Rust
	select BR2_RISCV_ISA_RVC			if BR2_PACKAGE_RESCUE_TARGET_RISCV64

	# Minimal system required packages
	select BR2_PACKAGE_RNG_TOOLS			# system entropy. Currently disabled for RK3128 due to high CPU impact
	select BR2_PACKAGE_IRQBALANCE			# irq balancing
	select BR2_PACKAGE_HOST_GENEXT2FS		# tools to generate rescue image
	select BR2_PACKAGE_DOSFSTOOLS			# fat
	select BR2_PACKAGE_DOSFSTOOLS_FSCK_FAT		# fat
	select BR2_PACKAGE_DOSFSTOOLS_MKFS_FAT		# fat
	select BR2_PACKAGE_DOSFSTOOLS_FATLABEL		# fat
	select BR2_PACKAGE_EXFATPROGS			# exfat
	select BR2_PACKAGE_E2FSPROGS			# ext4
	select BR2_PACKAGE_NTFS_3G			# ntfs
	select BR2_PACKAGE_NTFS_3G_NTFSPROGS		# ntfs
	select BR2_PACKAGE_BTRFS_PROGS			# btrfs
	select BR2_PACKAGE_USBMOUNT			# usb key/sd card mounter
	select BR2_PACKAGE_USBUTILS			# usb key/sd card tools
	select BR2_PACKAGE_KBD				# loadkeys

	# Disk tool
	select BR2_PACKAGE_PARTED			# partition management (for the first boot)
	select BR2_PACKAGE_GPTFDISK			# fs resize
	select BR2_PACKAGE_GPTFDISK_SGDISK		# fs resize
	select BR2_PACKAGE_E2FSPROGS			# fs resize
	select BR2_PACKAGE_E2FSPROGS_RESIZE2FS		# fs resize

	# Compression tools
	select BR2_PACKAGE_UNZIP			# for /userdata/system/upgrade/share.zip (What is this?)
	select BR2_PACKAGE_XZ				# for updates
	select BR2_PACKAGE_ZSTD				# for btrfs compression
	select BR2_PACKAGE_LZ4				# for initramfs compression
	select BR2_PACKAGE_GZIP				# Standard GNU compressor.
	select BR2_PACKAGE_TAR				# Manipulate tar files

	# Tools
	select BR2_PACKAGE_INSTALL2EMMC			if BR2_PACKAGE_RESCUE_TARGET_AARCH64 # Install system to emmc
	select BR2_PACKAGE_UBOOT_TOOLS		# mkimage needed
	select BR2_PACKAGE_UBOOT_TOOLS_MKIMAGE	# mkimage needed to rebuil boot.scr after new partition uuid
	select BR2_PACKAGE_UBOOT_TOOLS_DUMPIMAGE	# dumpimage needed to rebuil boot.scr after new partition uuid

	# text editor
	select BR2_PACKAGE_NANO				# basic nano emulator
	select BR2_PACKAGE_NANO_TINY			# optimize for size
	select BR2_PACKAGE_NCURSES_WCHAR		# enable wide char support

	help
		Rescue System

### ### ###
```
